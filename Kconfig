## Kconfig
```kconfig
config SECURITY_PTSEC
	bool "PTSEC SUPPORT"
	depends on SECURITY
	select NETWORK_SECMARK
	default n
	help
	  This selects BlabberMouth LSM.
          see recluze.wordpress.com for more details
```
